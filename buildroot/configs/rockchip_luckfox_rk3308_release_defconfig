## buildroot/configs/rockchip_luckfox_rk3308_release_defconfig
```kconfig
BR2_aarch64=y
BR2_cortex_a35=y
BR2_PRIMARY_SITE="http://sources.buildroot.net"
BR2_BACKUP_SITE=""
BR2_CCACHE=y
BR2_TOOLCHAIN_BUILDROOT_CXX=y
BR2_TARGET_GENERIC_HOSTNAME="rk3308_64"
BR2_TARGET_GENERIC_ISSUE="Welcome to RK3308 Buildroot"
BR2_ROOTFS_DEVICE_CREATION_DYNAMIC_EUDEV=y
BR2_ROOTFS_MERGED_USR=y
BR2_TARGET_GENERIC_ROOT_PASSWD="luckfox"
BR2_TARGET_SERIAL_SHELL_SH=y
BR2_ROOTFS_OVERLAY="board/rockchip/common/base board/rockchip/rk3308/fs-overlay/"
BR2_ROOTFS_POST_BUILD_SCRIPT="board/rockchip/common/post-build.sh"
BR2_LINUX_KERNEL_CUSTOM_LOCAL=y
BR2_LINUX_KERNEL_CUSTOM_LOCAL_LOCATION="$(TOPDIR)/../kernel"
BR2_PACKAGE_ROCKCHIP=y
BR2_PACKAGE_RK3308=y
BR2_PACKAGE_RKSCRIPT=y
BR2_PACKAGE_RKWIFIBT=y
BR2_PACKAGE_RKWIFIBT_APP=y
BR2_PACKAGE_ROCKCHIP_ALSA_CONFIG=y
BR2_PACKAGE_ROCKCHIP_TEST=y
BR2_PACKAGE_BUSYBOX_CONFIG_FRAGMENT_FILES="board/rockchip/common/base/busybox.fragment"
BR2_PACKAGE_BUSYBOX_SHOW_OTHERS=y
BR2_PACKAGE_ALSA_UTILS=y
BR2_PACKAGE_ALSA_UTILS_ALSACONF=y
BR2_PACKAGE_ALSA_UTILS_AMIXER=y
BR2_PACKAGE_ALSA_UTILS_APLAY=y
BR2_PACKAGE_BLUEZ_ALSA_HCITOP=y
BR2_PACKAGE_PULSEAUDIO=y
BR2_PACKAGE_PULSEAUDIO_DAEMON=y
BR2_PACKAGE_RT_TESTS=y
BR2_PACKAGE_STRACE=y
BR2_PACKAGE_STRESS=y
BR2_PACKAGE_DOSFSTOOLS=y
BR2_PACKAGE_DOSFSTOOLS_FATLABEL=y
BR2_PACKAGE_DOSFSTOOLS_FSCK_FAT=y
BR2_PACKAGE_DOSFSTOOLS_MKFS_FAT=y
BR2_PACKAGE_E2FSPROGS=y
BR2_PACKAGE_E2FSPROGS_RESIZE2FS=y
BR2_PACKAGE_FATRESIZE=y
BR2_PACKAGE_EVTEST=y
BR2_PACKAGE_I2C_TOOLS=y
BR2_PACKAGE_INPUT_EVENT_DAEMON=y
BR2_PACKAGE_PM_UTILS=y
BR2_PACKAGE_USBMOUNT=y
BR2_PACKAGE_PYTHON3=y
BR2_PACKAGE_PYTHON_PERIPHERY=y
BR2_PACKAGE_PYTHON_SERIAL=y
BR2_PACKAGE_PYTHON_SMBUS_CFFI=y
BR2_PACKAGE_PYTHON_SPIDEV=y
BR2_PACKAGE_ALSA_PLUGINS=y
BR2_PACKAGE_ALSA_UCM_CONF=y
BR2_PACKAGE_LIBMAD=y
BR2_PACKAGE_DHCPCD=y
BR2_PACKAGE_DNSMASQ=y
BR2_PACKAGE_DROPBEAR=y
# BR2_PACKAGE_DROPBEAR_CLIENT is not set
BR2_PACKAGE_GESFTPSERVER=y
BR2_PACKAGE_HOSTAPD=y
BR2_PACKAGE_IW=y
BR2_PACKAGE_NTP=y
BR2_PACKAGE_WPA_SUPPLICANT=y
BR2_PACKAGE_WPA_SUPPLICANT_AP_SUPPORT=y
BR2_PACKAGE_WPA_SUPPLICANT_AUTOSCAN=y
BR2_PACKAGE_WPA_SUPPLICANT_EAP=y
BR2_PACKAGE_WPA_SUPPLICANT_PASSPHRASE=y
BR2_PACKAGE_ANDROID_ADBD=y
BR2_PACKAGE_COREUTILS=y
BR2_PACKAGE_UTIL_LINUX_MOUNT=y
BR2_PACKAGE_NANO=y
BR2_TARGET_ROOTFS_CPIO=y
BR2_TARGET_ROOTFS_CPIO_GZIP=y
BR2_TARGET_ROOTFS_EXT2=y
BR2_TARGET_ROOTFS_EXT2_4=y
BR2_TARGET_ROOTFS_EXT2_SIZE="auto"
BR2_TARGET_ROOTFS_SQUASHFS=y
BR2_PACKAGE_HOST_ENVIRONMENT_SETUP=y
BR2_PACKAGE_HOST_NTFS_3G=y
BR2_PACKAGE_HOST_PYTHON3=y
BR2_PACKAGE_HOST_PYTHON3_SSL=y
```

## rtos/bsp/rockchip/pisces/applications/Kconfig
```kconfig
menu "Pisces application"

menuconfig RT_USING_OLPC_DEMO
    bool "olpc demo enable"
    default n

if RT_USING_OLPC_DEMO
    choice
        prompt "olpc app load mode"
        default OLPC_STATICLD_ENABLE
        config OLPC_STATICLD_ENABLE
            bool "static load mode"
        config OLPC_DLMODULE_ENABLE
            bool "dynamic load mode"
            depends on RT_USING_CUSTOM_DLMODULE
    endchoice

    config OLPC_APP_SRCSAVER_ENABLE
        bool "olpc screen saver enable"
        default n

    config OLPC_APP_CLOCK_ENABLE
        bool "olpc clock demo select"
        default n

    if OLPC_APP_CLOCK_ENABLE
        config OLPC_APP_CLOCK_BLN_ENABLE
            bool "olpc clock breathlight enable"
            default y

        choice
            prompt "olpc clock style select"
            default OLPC_APP_CLOCK_STYLE_ROUND_ARABIC

            config OLPC_APP_CLOCK_STYLE_ROUND_ARABIC
                bool "select round disc with Arabic number"

            config OLPC_APP_CLOCK_STYLE_ROUND_ROMAN332
                bool "select round disc with Roman number base on RGB332"

            config OLPC_APP_CLOCK_STYLE_ROUND_ROMAN565
                bool "select round disc with Roman number base on RGB565"
        endchoice

    endif

    config OLPC_APP_EBOOK_ENABLE
        bool "olpc ebook demo select"
        default n

    config OLPC_APP_BLOCK_ENABLE
        bool "olpc block game select"
        default n

    config OLPC_APP_SNAKE_ENABLE
        bool "olpc snake game select"
        default n

    config OLPC_APP_NOTE_ENABLE
        bool "olpc note demo select"
        depends on RT_USING_DTCM_HEAP
        default n

    config OLPC_APP_XSCREEN_ENABLE
        bool "olpc x-screen demo select"
        depends on RT_USING_DTCM_HEAP
        default n

    config OLPC_APP_JUPITER_ENABLE
        bool "olpc jupiter demo select"
        depends on RT_USING_DTCM_HEAP
        default n

    config OLPC_APP_BLN_ENABLE
        bool "olpc breathing light demo select"
        depends on (!RT_USING_DTCM_HEAP) && (RT_USING_DSPFW_BUILTIN) && (!OLPC_DLMODULE_ENABLE)
        default n

    config OLPC_APP_LYRIC_ENABLE
        bool "olpc lyric demo select"
        default n
endif

endmenu
```

## rtos/bsp/rockchip/pisces/board/fpga/defconfig
```kconfig
CONFIG_RT_USING_CORE_RTTHREAD=y
CONFIG_ARCH_ARM=y
CONFIG_ARCH_ARM_CORTEX_M4=y
CONFIG_ARCH_ARM_CORTEX_M=y
CONFIG_FINSH_ARG_MAX=10
CONFIG_FINSH_CMD_SIZE=80
CONFIG_FINSH_HISTORY_LINES=5
CONFIG_FINSH_THREAD_NAME="tshell"
CONFIG_FINSH_THREAD_PRIORITY=20
CONFIG_FINSH_THREAD_STACK_SIZE=4096
CONFIG_FINSH_USING_DESCRIPTION=y
CONFIG_FINSH_USING_HISTORY=y
CONFIG_FINSH_USING_MSH=y
CONFIG_FINSH_USING_MSH_DEFAULT=y
CONFIG_FINSH_USING_SYMTAB=y
CONFIG_IDLE_THREAD_STACK_SIZE=256
CONFIG_PKG_CMBACKTRACE_DUMP_STACK=y
CONFIG_PKG_CMBACKTRACE_PLATFORM_M4=y
CONFIG_PKG_CMBACKTRACE_PRINT_ENGLISH=y
CONFIG_PM_HAS_CUSTOM_CONFIG=y
CONFIG_RKMCU_PISCES=y
CONFIG_RT_ALIGN_SIZE=4
CONFIG_RT_CONFIG_H__=y
CONFIG_RT_CONSOLEBUF_SIZE=128
CONFIG_RT_CONSOLE_DEVICE_NAME="uart0"
CONFIG_RT_DEBUG=y
CONFIG_RT_DEBUG_COLOR=y
CONFIG_RT_DEBUG_USING_IO=y
CONFIG_RT_IDEL_HOOK_LIST_SIZE=4
CONFIG_RT_NAME_MAX=8
CONFIG_RT_PIPE_BUFSZ=512
CONFIG_RT_SERIAL_RB_BUFSZ=64
CONFIG_RT_SERIAL_USING_DMA=y
CONFIG_RT_THREAD_PRIORITY_32=y
CONFIG_RT_THREAD_PRIORITY_MAX=32
CONFIG_RT_TICK_PER_SECOND=1000
CONFIG_RT_UNCACHE_HEAP_ORDER=0x0E
CONFIG_RT_USING_AUDIO=y
CONFIG_RT_USING_BOARD_FPGA=y
CONFIG_RT_USING_CMBACKTRACE=y
CONFIG_RT_USING_COMMON_TEST=y
CONFIG_RT_USING_COMPONENTS_INIT=y
CONFIG_RT_USING_CONSOLE=y
CONFIG_RT_USING_CRU=y
CONFIG_RT_USING_DEVICE=y
CONFIG_RT_USING_DEVICE_IPC=y
CONFIG_RT_USING_DMA=y
CONFIG_RT_USING_DMA_PL330=y
CONFIG_RT_USING_DSI=y
CONFIG_RT_USING_DSP=y
CONFIG_RT_USING_EVENT=y
CONFIG_RT_USING_FINSH=y
CONFIG_RT_USING_HEAP=y
CONFIG_RT_USING_HOOK=y
CONFIG_RT_USING_I2C0=y
CONFIG_RT_USING_I2C1=y
CONFIG_RT_USING_I2C2=y
CONFIG_RT_USING_I2C=y
CONFIG_RT_USING_I2C_BITOPS=y
CONFIG_RT_USING_I2STDM=y
CONFIG_RT_USING_IDLE_HOOK=y
CONFIG_RT_USING_LIBC=y
CONFIG_RT_USING_MAILBOX=y
CONFIG_RT_USING_MEMHEAP=y
CONFIG_RT_USING_MEMPOOL=y
CONFIG_RT_USING_MESSAGEQUEUE=y
CONFIG_RT_USING_MUTEX=y
CONFIG_RT_USING_OVERFLOW_CHECK=y
CONFIG_RT_USING_PANEL_SS=y
CONFIG_RT_USING_PCM=y
CONFIG_RT_USING_PDM=y
CONFIG_RT_USING_PIN=y
CONFIG_RT_USING_PM=y
CONFIG_RT_USING_SEMAPHORE=y
CONFIG_RT_USING_SERIAL=y
CONFIG_RT_USING_SMALL_MEM=y
CONFIG_RT_USING_SPI1=y
CONFIG_RT_USING_SPI2APB=y
CONFIG_RT_USING_SPI=y
CONFIG_RT_USING_TC=y
CONFIG_RT_USING_UART0=y
CONFIG_RT_USING_UART=y
CONFIG_RT_USING_UNCACHE_HEAP=y
CONFIG_RT_USING_VAD=y
CONFIG_RT_USING_VOP=y
CONFIG_RT_VER_NUM=0x30103
```

## rtos/bsp/rockchip/pisces/drivers/Kconfig
```kconfig
source "$BSP_DIR/../common/drivers/Kconfig"

menu "RT-Thread rockchip pisces drivers"

config RT_USING_CRU
    bool "Enable CRU"
    default n

    if RT_USING_CRU
    config PLL_INPUT_OSC_RATE
        int "the osc rate for soc"
        default 24000000
    endif

config RT_USING_DMA
    bool "Enable General DMA Framework"
    default n

config RT_USING_DMA_PL330
    bool "Enable PL330 DMA Controller"
    depends on RT_USING_DMA
    default n

config RT_USING_PMU
    bool "Enable PMU"
    default n

config RT_USING_RGB
    bool "Enable RGB"
    default n

config RT_USING_VOP
    bool "Enable VOP"
    default n

config RT_USING_DSI
     bool "Enable MIPI DSI"
     default n

menu "Enable DSP"
    config RT_USING_DSP
        bool "Enable DSP"
        default n

    if RT_USING_DSP
    config RT_USING_DSPFW_LOADER
        bool "Enable firmware loader to dsp"
        default n

        if RT_USING_DSPFW_LOADER
        config RT_USING_DSPFW_BUILTIN
            bool "Store firmware data in builtin"
            default y
        endif

    config RT_USING_DSP_TRACE
        bool "Enable dsp send trace to cm4"
        default n

    config RT_DSP_UART_PORT
        int "Config dsp debug uart port"
        range -1 1
        default -1
        help
            set -1, will not set uart port to dsp

    endif
endmenu

menu "Enable UART"
    config RT_USING_UART
        bool "Enable UART"
        default n

    if RT_USING_UART
    config RT_USING_UART0
        bool "Enable UART0"
        default n

    config RT_USING_UART1
        bool "Enable UART1"
        default n
    endif
endmenu

if RT_USING_I2C
menu "Enable I2C"
    config RT_USING_I2C0
        bool "Enable I2C0"
        default n

    config RT_USING_I2C1
        bool "Enable I2C1"
        default n

    config RT_USING_I2C2
        bool "Enable I2C2"
        default n
endmenu
endif

if RT_USING_SPI
menu "Enable SPI"
    config RT_USING_SPI2APB
        bool "Enable SPI0 (SPI2APB)"
        default n

    config RT_USING_SPI1
        bool "Enable SPI1"
        default n
endmenu
endif

if RT_USING_AUDIO
menu "Enable Audio"
    config RT_USING_PCM
        bool "Enable PCM"
        select RT_USING_DMA
        default y

    config RT_USING_I2STDM
        bool "Enable I2STDM"
        default n

    config RT_USING_I2STDM0
        bool "Enable I2STDM0"
        depends on RT_USING_I2STDM
        default n

    config RT_USING_PDM
        bool "Enable PDM"
        default n

    config RT_USING_PDM0
        bool "Enable PDM0"
        depends on RT_USING_PDM
        default n

    config RT_USING_VAD
        bool "Enable VAD"
        default n

    choice
        prompt "VAD irq handler"
        depends on RT_USING_VAD
        default RT_VAD_IRQ_HANDLED_BY_DSP

        config RT_VAD_IRQ_HANDLED_BY_DSP
            bool "handled by DSP"

        config RT_VAD_IRQ_HANDLED_BY_CPU
            bool "handled by CPU"

    endchoice

    config RT_USING_AUDIO_CARD_MIC
        bool "Select mics audio card"
        select RT_USING_CODEC
        default n

    choice
        prompt "mics type"
        depends on RT_USING_AUDIO_CARD_MIC

        config RT_USING_AUDIO_CARD_ANALOG_MIC
            select RT_USING_I2STDM
            select RT_USING_ACDCDIG
            bool "Enable internal analog mics audio card"

        config RT_USING_AUDIO_CARD_I2S_MIC
            select RT_USING_I2STDM
            bool "Enable i2s digital mics audio card"

        config RT_USING_AUDIO_CARD_PDM_MIC
            select RT_USING_PDM
            bool "Enable pdm digital mics audio card"

    endchoice

    source "$BSP_DIR/../common/drivers/audio/codecs/Kconfig"
endmenu
endif

menuconfig RT_USING_PISCES_TOUCH
    bool "Enable Touch"
    default n

if RT_USING_PISCES_TOUCH
    config RT_USING_PISCES_TOUCH_ASYNC
        bool "Enable Touch Async"
        default y
endif

config RT_USING_SYSTICK
    bool "Enable SYSTICK"
    default n

endmenu
```

## rtos/bsp/rockchip/pisces/tests/Kconfig
```kconfig
menu "RT-Thread bsp test case"

config RT_USING_PRIVATE_TEST
    bool "Enable BSP Private TEST"
    default n

    if RT_USING_PRIVATE_TEST
    config RT_USING_COMMON_TEST_DISPLAY
        bool "Enable BSP Common DISPLAY TEST"
        depends on RT_USING_VOP
        default n

    config RT_USING_COMMON_TEST_TOUCH
        bool "Enable Touch TEST"
        depends on RT_USING_PISCES_TOUCH
        default n
    endif

source "$BSP_DIR/../common/tests/Kconfig"

endmenu
```
